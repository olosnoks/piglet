/*
 * PigletNodeC3 — Standalone ESP-Now Mesh Node
 * Target: ESP32-C3 "0.42-inch OLED" dev board (72x40 SSD1306)
 *
 * Port of PigletNode (https://github.com/Hamspiced/piglet/tree/main/PigletNode)
 * from the XIAO ESP32-C5 to the ESP32-C3 0.42" OLED board.
 *
 * Differences from the C5 original:
 *   - ESP32-C3 is 2.4 GHz only. The full JCMK channel table is kept so
 *     channel indices still match the Core, but 5 GHz entries are skipped.
 *     If the Core assigns a range with no 2.4 GHz channels, the node falls
 *     back to scanning 2.4 GHz ch 1-14 so it isn't idle.
 *   - Onboard 72x40 OLED (SDA=GPIO5, SCL=GPIO6) shows an animated Piglet
 *     in a scrolling world (with a flock of nearby nodes' pigs), a 2.4 GHz
 *     channel graph, or a stats page; short-press BOOT to cycle through them.
 *     Sprites live in pig_sprites.h, generated by tools/sprites (see README).
 *   - LED is GPIO8 (active LOW), BOOT button is GPIO9.
 *   - BLE: a 0.5 s active scan after each Wi-Fi cycle (JCMK node style);
 *     new devices go to the Core as "MAC,NAME,[BLE],0,RSSI,B". A stock
 *     Piglet Core logs these as WIFI rows — apply core-patch/ first.
 *
 * Compatible with:
 *   - Piglet (XIAO ESP32-S3/C5/C6) in Core mode
 *   - Piglet T-Dongle C5 in Core mode
 *   - justcallmekoko/ESP32Marauder (core role)
 *
 * Requires library: U8g2 (Library Manager → "U8g2" by oliver)
 *
 * License: CC BY-NC-SA 4.0 (same as upstream)
 */

#include <Arduino.h>
#include <WiFi.h>
#include <Wire.h>
#include <esp_now.h>
#include "esp_wifi.h"
#include "esp_mac.h"
#include <U8g2lib.h>
#include <NimBLEDevice.h>
#include "pig_sprites.h"

#define FIRMWARE_VERSION "v2.58-c3"

// ================================================================
//  Board — ESP32-C3 0.42" OLED
// ================================================================

// BOOT button (GPIO9, INPUT_PULLUP, LOW = pressed).
// Short press flips the OLED page; hold >2 s to force a re-search.
static const int BTN_PIN = 9;

// Onboard blue LED — GPIO8, active LOW.
static const int  LED_PIN        = 8;
static const bool LED_ACTIVE_LOW = true;

// OLED — SSD1306 72x40 on I2C
static const int OLED_SDA = 5;
static const int OLED_SCL = 6;
U8G2_SSD1306_72X40_ER_F_HW_I2C oled(U8G2_R0, /*reset*/ U8X8_PIN_NONE,
                                    /*clock*/ OLED_SCL, /*data*/ OLED_SDA);

// ================================================================
//  JCMK protocol constants  (must match Piglet Core exactly)
// ================================================================
static const uint8_t  ESPNOW_CH           = 6;
static const uint8_t  JCMK_MAGIC[4]       = {'E', 'N', 'O', 'W'};
static const uint8_t  JCMK_BCAST[6]       = {0xFF,0xFF,0xFF,0xFF,0xFF,0xFF};
static const uint32_t REQ_INIT_MS         = 300;
static const uint32_t REQ_MAX_MS          = 5000;
static const uint32_t HB_MS              = 5000;
static const uint32_t SCAN_DWELL_MS      = 80;   // ms per channel
static const uint32_t ADMIN_WIN_MS       = 500;  // ch-6 window after each scan cycle
static const uint32_t CORE_TIMEOUT_MS    = 90000; // re-search if no ADMIN for 90 s
#define JCMK_TEXT_MAX 200

enum JcmkMsgType : uint8_t {
  MSG_CORE_REQUEST = 1,
  MSG_CORE_REPLY   = 2,
  MSG_HEARTBEAT    = 3,
  MSG_TEXT         = 4,
  MSG_ADMIN        = 5
};

typedef struct __attribute__((packed)) {
  char     magic[4];
  uint8_t  type;
  uint32_t counter;
  uint16_t len;
  char     text[JCMK_TEXT_MAX + 1];
} jcmk_text_msg_t;  // 212 bytes — full size required by Biscuit Node/Pro

typedef struct __attribute__((packed)) {
  char    magic[4];
  uint8_t type;
  uint8_t assignment_version;
  uint8_t node_index;
  uint8_t node_count;
  uint8_t start_channel_idx;
  uint8_t end_channel_idx;
} jcmk_admin_msg_t;

// JCMK dual-band channel table (2.4 GHz + 5 GHz)
// Indices are shared with the Core — do NOT reorder.
static const uint8_t CHANNELS[] = {
  // 2.4 GHz (ch 1-14)
  1, 2, 3, 4, 5, 6, 7, 8, 9, 10, 11, 12, 13, 14,
  // 5 GHz UNII-1/2/2e/3 (not supported by ESP32-C3 — skipped)
  36, 40, 44, 48, 52, 56, 60, 64,
  100, 112, 116, 120, 124, 128, 132, 136, 140, 144,
  149, 153, 157, 161, 165, 169, 173, 177
};
static const uint8_t NUM_CHANNELS = (uint8_t)(sizeof(CHANNELS));
static const uint8_t LAST_24G_IDX = 13;  // CHANNELS[13] == 14

// ================================================================
//  Node state
// ================================================================
static bool     nodeActive    = false;
static bool     haveCore      = false;
static uint8_t  coreMac[6]   = {0};
static uint8_t  startIdx      = 0;
static uint8_t  endIdx        = NUM_CHANNELS - 1;  // default = all channels
static uint8_t  assignVer     = 0;
static uint32_t netFound      = 0;
static uint32_t netSent       = 0;
static uint32_t netNew        = 0;      // unique BSSIDs seen since boot
static uint32_t bleNew        = 0;      // unique BLE addresses sent to the Core
static uint32_t bleSeenTotal  = 0;      // BLE advertisements heard (incl. repeats)
static bool     hopPending    = false;  // tells the pig a new network appeared
static uint32_t hbCounter     = 0;
static uint32_t lastHbMs      = 0;
static uint32_t lastReqMs     = 0;
static uint32_t reqInterval   = REQ_INIT_MS;
static uint32_t lastAdminMs   = 0;  // tracks last ADMIN from Core for timeout

// Per-channel scan state
static bool     scanActive    = false;
static uint8_t  scanChOffset  = 0;
static bool     scanAdminWin  = false;
static uint32_t scanAdminMs   = 0;
static uint8_t  scanCurCh     = 0;  // channel currently being scanned (for display)
static uint8_t  chCount[14]   = {0}; // networks in the latest scan of each 2.4 GHz channel

// OLED page, flipped by a short BOOT press
enum OledPage : uint8_t { PAGE_PIG = 0, PAGE_GRAPH, PAGE_STATS, PAGE_COUNT };
static uint8_t  oledPage      = PAGE_PIG;

// Stats page bookkeeping
enum AuthKind : uint8_t { AK_OPEN, AK_WEP, AK_WPA2, AK_WPA3, AK_EAP, AK_COUNT };
static uint32_t authCount[AK_COUNT] = {0};  // unique networks by security type
static uint32_t linkedMs      = 0;          // when we linked to the current Core
static uint32_t partiesSeen   = 0;
static int8_t   bestRssi      = -127;       // strongest network heard recently
static uint8_t  bestCh        = 0;
static char     bestSsid[19]  = "";
static uint32_t bestMs        = 0;

// Pending core-found event (set from ESP-Now callback, consumed in loop)
static volatile bool coreFoundPending  = false;
static uint8_t       coreMacPending[6] = {0};

// ================================================================
//  Effective 2.4 GHz scan range
//  Clamp the Core's assignment to 2.4 GHz. If the assignment is
//  entirely 5 GHz, fall back to all of 2.4 GHz so the node stays useful.
// ================================================================
static bool effRange(uint8_t& s, uint8_t& e) {
  s = startIdx;
  e = (endIdx > LAST_24G_IDX) ? LAST_24G_IDX : endIdx;
  if (s > LAST_24G_IDX || e < s) {
    s = 0;
    e = LAST_24G_IDX;
    return true;  // fallback in use
  }
  return false;
}

// ================================================================
//  Unique BSSID tracking (FNV-1a hash set, open addressing)
//  Returns true the first time a BSSID is seen. Stops adding once
//  SEEN_MAX is reached, so very long sessions just stop hopping.
// ================================================================
static const uint16_t SEEN_CAP = 1024;           // power of two
static const uint16_t SEEN_MAX = SEEN_CAP * 7 / 8;
static uint32_t seenHash[SEEN_CAP] = {0};
static uint16_t seenCount = 0;

static bool markSeen(const uint8_t* bssid) {
  uint32_t h = 2166136261u;
  for (int i = 0; i < 6; i++) h = (h ^ bssid[i]) * 16777619u;
  if (h == 0) h = 1;  // 0 marks an empty slot
  uint16_t i = h & (SEEN_CAP - 1);
  while (seenHash[i]) {
    if (seenHash[i] == h) return false;
    i = (i + 1) & (SEEN_CAP - 1);
  }
  if (seenCount >= SEEN_MAX) return false;
  seenHash[i] = h;
  seenCount++;
  return true;
}

// ================================================================
//  BLE — JCMK-style: a short active scan in the ch-6 admin window after
//  each Wi-Fi cycle. Each new address goes to the Core once, as
//    MAC,NAME,[BLE],0,RSSI,B
//  (JCMK node format; Piglet Core needs the ble-core patch to log it as
//  a WiGLE "BLE" row). Phones rotate random addresses, so the BLE seen-set
//  is cleared when full rather than frozen like the Wi-Fi one.
// ================================================================
static const uint32_t BLE_SCAN_MS   = 500;
static const uint16_t BLE_SEEN_CAP  = 2048;              // power of two
static const uint16_t BLE_SEEN_MAX  = BLE_SEEN_CAP * 7 / 8;
static uint32_t bleSeenHash[BLE_SEEN_CAP] = {0};
static uint16_t bleSeenCount = 0;

static bool bleMarkSeen(const uint8_t* addr) {
  uint32_t h = 2166136261u;
  for (int i = 0; i < 6; i++) h = (h ^ addr[i]) * 16777619u;
  if (h == 0) h = 1;
  uint16_t i = h & (BLE_SEEN_CAP - 1);
  while (bleSeenHash[i]) {
    if (bleSeenHash[i] == h) return false;
    i = (i + 1) & (BLE_SEEN_CAP - 1);
  }
  if (bleSeenCount >= BLE_SEEN_MAX) {                    // full: start over
    memset(bleSeenHash, 0, sizeof(bleSeenHash));
    bleSeenCount = 0;
    i = h & (BLE_SEEN_CAP - 1);
  }
  bleSeenHash[i] = h;
  bleSeenCount++;
  return true;
}

// Results arrive in the NimBLE host task; queue them for the main loop,
// which dedupes and sends on ch 6. Single producer, single consumer.
struct BleHit { uint8_t addr[6]; int8_t rssi; char mac[18]; char name[33]; };
static const uint8_t BLE_Q = 32;
static BleHit           bleQ[BLE_Q];
static volatile uint8_t bleQHead = 0, bleQTail = 0;
static NimBLEScan*      bleScan  = nullptr;

class BleScanCb : public NimBLEScanCallbacks {
  void onResult(const NimBLEAdvertisedDevice* d) override {
    bleSeenTotal++;
    uint8_t next = (bleQTail + 1) % BLE_Q;
    if (next == bleQHead) return;                       // queue full: drop
    BleHit& e = bleQ[bleQTail];
    const NimBLEAddress& a = d->getAddress();
    memcpy(e.addr, a.getVal(), 6);
    e.rssi = (int8_t)d->getRSSI();
    snprintf(e.mac, sizeof(e.mac), "%s", a.toString().c_str());
    for (char* p = e.mac; *p; p++) *p = toupper(*p);    // match WiFi.BSSIDstr()
    // Name goes in the SSID field: strip commas/control chars so the CSV parsers don't split it
    std::string nm = d->haveName() ? d->getName() : std::string();
    size_t k = 0;
    for (char c : nm) {
      if (k >= sizeof(e.name) - 1) break;
      e.name[k++] = (c == ',' || (uint8_t)c < 0x20 || c == 0x7f) ? ' ' : c;
    }
    e.name[k] = '\0';
    bleQTail = next;
  }
};
static BleScanCb bleCb;

static void bleInit() {
  NimBLEDevice::init("");
  bleScan = NimBLEDevice::getScan();
  bleScan->setScanCallbacks(&bleCb, false);   // report each address once per scan
  bleScan->setActiveScan(true);               // ask for scan responses, which carry most names
  bleScan->setInterval(100);
  bleScan->setWindow(99);
  bleScan->setMaxResults(0);                  // don't keep results; we queue them ourselves
}

static bool bleBusy() { return bleScan && bleScan->isScanning(); }

// ================================================================
//  LED
// ================================================================
static void ledWrite(bool on) {
  digitalWrite(LED_PIN, LED_ACTIVE_LOW ? !on : on);
}

// Non-blocking blink: fast (200 ms) = searching, slow (1000 ms) = linked
static void ledTick() {
  static uint32_t lastMs = 0;
  static bool     state  = false;
  uint32_t now = millis();
  uint32_t interval = haveCore ? 1000 : 200;
  if (now - lastMs >= interval) {
    lastMs = now;
    state  = !state;
    ledWrite(state);
  }
}

// ================================================================
//  OLED (72x40) — page 1: Piglet mascot, page 2: channel graph
// ================================================================
static void oledMessage(const char* l1, const char* l2 = "", const char* l3 = "") {
  oled.clearBuffer();
  oled.setFont(u8g2_font_5x8_tf);
  oled.drawStr(0, 8,  l1);
  oled.drawStr(0, 20, l2);
  oled.drawStr(0, 32, l3);
  oled.sendBuffer();
}

// ----------------------------------------------------------------
//  Piglet mascot — 30x18 1-bit bitmaps from pig_sprites.h, drawn
//  mirrored when walking left. The pig trots in place over a
//  scrolling ground under parallax clouds; only the unique-network
//  count is shown, top right.
// ----------------------------------------------------------------

// Draw rows of a 1-bit bitmap (MSB = leftmost) in the given color.
static void blit(const uint32_t* rows, int w, int h, int x, int y, bool flip, uint8_t color) {
  oled.setDrawColor(color);
  for (int j = 0; j < h; j++) {
    uint32_t r = rows[j];
    if (!r) continue;
    for (int i = 0; i < w; i++)
      if (r & (0x80000000u >> i)) {
        int px = x + (flip ? w - 1 - i : i), py = y + j;
        if (px >= 0 && px < 72 && py >= 0 && py < 40) oled.drawPixel(px, py);
      }
  }
  oled.setDrawColor(1);
}

// Same integer hash as the Sprite Lab preview, so the ground looks identical
static uint32_t groundHash(uint32_t n) {
  n = (n ^ 61 ^ (n >> 16)) * 9u;
  n ^= n >> 4;
  n *= 0x27d4eb2du;
  return n ^ (n >> 15);
}

static void safePixel(int x, int y) {
  if (x >= 0 && x < 72 && y >= 0 && y < 40) oled.drawPixel(x, y);
}

static int32_t rnd(uint32_t n) { return (int32_t)(esp_random() % n); }
static float    rndf()         { return (esp_random() % 10000) / 10000.0f; }
static int32_t  floorDiv(int32_t a, int32_t b) { return (a >= 0) ? a / b : -((-a + b - 1) / b); }

// ----------------------------------------------------------------
//  Clouds — 1-3 at a time, each with its own shape, height, wind
//  speed and depth (parallax). New ones arrive after random gaps.
// ----------------------------------------------------------------
struct CloudShape { const uint32_t* rows; uint8_t w, h; };
static const CloudShape CLOUD_SHAPES[5] = {
  {CLOUD1, CLOUD1_W, CLOUD1_H}, {CLOUD2, CLOUD2_W, CLOUD2_H}, {CLOUD3, CLOUD3_W, CLOUD3_H},
  {CLOUD4, CLOUD4_W, CLOUD4_H}, {CLOUD5, CLOUD5_W, CLOUD5_H},
};
struct Cloud { uint8_t shape; float x; uint8_t y; float depth, wind; };
static Cloud   clouds[4];
static uint8_t cloudCount = 0;

// side: 0 anywhere on screen, -1 off the left edge, +1 off the right edge
static void newCloud(Cloud& c, int side) {
  c.shape = rnd(5);
  int w = CLOUD_SHAPES[c.shape].w;
  c.x = side == 0 ? rnd(90) - 10 : side < 0 ? -w - rnd(90) : 72 + rnd(90);
  c.y = 1 + rnd(13);
  c.depth = 0.12f + rndf() * 0.25f;
  c.wind  = 0.02f + rndf() * 0.05f;
}

static void cloudsTick(int scrollDir) {
  if (!cloudCount) {
    cloudCount = 1 + rnd(3);
    for (int i = 0; i < cloudCount; i++) newCloud(clouds[i], 0);
  }
  for (int i = 0; i < cloudCount; i++) {
    Cloud& c = clouds[i];
    const CloudShape& s = CLOUD_SHAPES[c.shape];
    c.x -= c.wind + scrollDir * c.depth;
    if (c.x < -s.w - 2) newCloud(c, 1);
    else if (c.x > 74)  newCloud(c, -1);
    blit(CLOUD_SHAPES[c.shape].rows, CLOUD_SHAPES[c.shape].w, CLOUD_SHAPES[c.shape].h,
         (int)lroundf(c.x), c.y, false, 1);
  }
}

// ----------------------------------------------------------------
//  Birds — every 20-60 s one bird, or now and then a loose V of 2-3,
//  crosses the sky at 1.2-1.8 px/frame, flapping (and sometimes
//  gliding), with 0.4x parallax. In front of clouds, behind trees.
// ----------------------------------------------------------------
struct Bird { float x, y, vx; uint8_t ph, glide; uint16_t age; };
static Bird    birds[3];
static uint8_t birdCount = 0;
static int32_t birdWait  = 400;

static void birdsTick(int scrollDir) {
  if (!birdCount) {
    if (--birdWait > 0) return;
    bool fromLeft = esp_random() & 1;
    int  dir = fromLeft ? 1 : -1;
    float vx = dir * (1.2f + rndf() * 0.6f);
    int  y = 3 + rnd(10);
    birdCount = rnd(10) < 7 ? 1 : 2 + rnd(2);
    for (int i = 0; i < birdCount; i++)   // followers trail behind the leader, a little lower
      birds[i] = {(fromLeft ? -8.0f : 73.0f) - dir * i * 9, (float)(y + i * 3 - (i > 1 ? 5 : 0)), vx,
                  (uint8_t)rnd(8), 0, 0};
  }
  static const uint32_t* const FLAP[4] = {BIRD_UP, BIRD_MID, BIRD_DOWN, BIRD_MID};
  bool gone = true;
  for (int i = 0; i < birdCount; i++) {
    Bird& b = birds[i];
    b.age++;
    b.x += b.vx - scrollDir * 0.4f;
    if (b.glide) b.glide--;
    else if (rnd(100) < 2) b.glide = 10 + rnd(10);            // now and then it glides
    const uint32_t* g = b.glide ? BIRD_MID : FLAP[((b.age + b.ph) >> 1) & 3];
    blit(g, BIRD_UP_W, BIRD_UP_H, (int)lroundf(b.x), (int)lroundf(b.y + sinf(b.age * 0.15f + b.ph)), false, 1);
    if (b.x > -10 && b.x < 82) gone = false;
  }
  if (gone) { birdCount = 0; birdWait = 400 + rnd(800); }
}

// ----------------------------------------------------------------
//  Ground — rolls between rows 32 and 38 so no row burns in.
//  Trees: the world is split into 2000 px cells, each holding one tree
//  (oak, pine, birch, apple or bare) within its first 200 px, so trees
//  are at least 1800 px (90 s of trotting) apart. Same hash as the Sprite Lab.
// ----------------------------------------------------------------
static const int GROUND_BASE = 36;
static const int TREE_CELL   = 2000;

static int hill(int32_t wx) {
  int h = (int)lroundf(2.4f * sinf(wx * 0.07f) + 1.2f * sinf(wx * 0.19f + 1.0f));
  return h < -4 ? -4 : h > 2 ? 2 : h;                   // peaks reach row 32, dips row 38
}
static int groundAt(int sx, int32_t gx) { return GROUND_BASE + hill(sx + gx); }

struct TreeShape { const uint32_t* rows; uint8_t w, h; };
static const TreeShape TREE_SHAPES[5] = {
  {OAK, OAK_W, OAK_H}, {PINE, PINE_W, PINE_H}, {BIRCH, BIRCH_W, BIRCH_H},
  {APPLE, APPLE_W, APPLE_H}, {BARE, BARE_W, BARE_H},
};
struct Tree { int32_t wx; const uint32_t* rows; uint8_t w, h; };
static bool treeIn(int32_t cell, Tree& tr) {
  uint32_t h = groundHash((uint32_t)(cell * 7 + 12345));
  const TreeShape& s = TREE_SHAPES[(h >> 4) % 5];
  tr = {cell * TREE_CELL + (int32_t)((h >> 8) % 200), s.rows, s.w, s.h};
  return true;
}
// Any tree overlapping world columns a..b? Keeps dig sites clear of trunks.
static bool treeBetween(int32_t a, int32_t b) {
  Tree tr;
  for (int32_t c = floorDiv(a - 32, TREE_CELL); c <= floorDiv(b, TREE_CELL); c++)
    if (treeIn(c, tr) && tr.wx <= b && tr.wx + tr.w >= a) return true;
  return false;
}

// The latest dig site, in world coordinates: a U-shaped hole and a dirt mound
struct DigSite { bool active; int32_t hx, mx; uint8_t mound; };
static DigSite site = {false};

static void drawWorld(int32_t gx, int scrollDir) {
  cloudsTick(scrollDir);
  birdsTick(scrollDir);

  Tree tr;
  for (int32_t c = floorDiv(gx - 40, TREE_CELL); c <= floorDiv(gx + 72, TREE_CELL); c++) {
    if (!treeIn(c, tr)) continue;
    int sx = tr.wx - gx;
    blit(tr.rows, tr.w, tr.h, sx, groundAt(sx + tr.w / 2, gx) - tr.h + 1, false, 1);
  }

  for (int sx = 0; sx < 72; sx++) {
    int32_t  wx = sx + gx;
    uint32_t h  = groundHash((uint32_t)(wx + 100000));
    int gy = groundAt(sx, gx), py = groundAt(sx - 1, gx);
    if (site.active && wx >= site.hx && wx < site.hx + 7) {   // dug hole: the line dips into a U
      bool edge = (wx == site.hx || wx == site.hx + 6);
      safePixel(sx, gy + (edge ? 1 : 2));
      if (!edge) safePixel(sx, gy + 3);
      continue;
    }
    safePixel(sx, gy);
    for (int y = min(gy, py) + 1; y < max(gy, py); y++) safePixel(sx, y);  // keep steep steps joined
    if (h % 7 == 0)  safePixel(sx, gy + 1 + (h >> 3) % 2);              // pebble
    if (h % 29 == 0) { safePixel(sx, gy - 1); safePixel(sx + 1, gy - 2);
                       safePixel(sx + 2, gy - 1); }                     // grass tuft
    if (h % 53 == 0) { safePixel(sx, gy - 1); safePixel(sx, gy - 2);
                       safePixel(sx + 1, gy - 3); safePixel(sx - 1, gy - 3); } // sprout
  }

  if (site.active && site.mound) {
    static const uint32_t* const M[4] = {nullptr, MOUND1, MOUND2, MOUND3};
    static const uint8_t MW[4] = {0, MOUND1_W, MOUND2_W, MOUND3_W};
    int sx = site.mx - gx;
    blit(M[site.mound], MW[site.mound], 3, sx, groundAt(sx + 4, gx) - 3, false, 1);
  }
  if (site.active && (site.hx - gx < -40 || site.hx - gx > 110)) site.active = false;
}

// ----------------------------------------------------------------
//  Butterfly (11x9) — flutters across every 10-40 s at a random
//  height, bobbing on two sine waves. It drifts with the scenery at
//  half the ground speed and is drawn behind the pig.
// ----------------------------------------------------------------
struct Butterfly { bool active; float x, vx, y0, ph; uint16_t age; };
static Butterfly bfly = {false};
static int32_t   bflyWait = 200;             // frames until the next one

static void butterflyTick(int scrollDir) {
  if (!bfly.active) {
    if (--bflyWait > 0) return;
    bool fromLeft = esp_random() & 1;
    bfly = {true, fromLeft ? -12.0f : 73.0f, (fromLeft ? 1 : -1) * (0.45f + rndf() * 0.35f),
            8.0f + rnd(18), rndf() * 6.28f, 0};
  }
  bfly.age++;
  bfly.x  += bfly.vx - scrollDir * 0.5f;
  bfly.ph += 0.25f;

  float fy = bfly.y0 + sinf(bfly.ph) * 3 + sinf(bfly.ph * 0.37f) * 4;
  int bx = (int)lroundf(bfly.x);
  int by = (int)lroundf(fy < 1 ? 1 : fy > 24 ? 24 : fy);
  static const uint32_t* const FLAP[4] = {BFLY_OPEN, BFLY_HALF, BFLY_SHUT, BFLY_HALF};
  blit(FLAP[(bfly.age >> 1) & 3], BFLY_OPEN_W, BFLY_OPEN_H, bx, by, false, 1);

  if (bfly.x < -14 || bfly.x > 80) {
    bfly.active = false;
    bflyWait = 200 + rnd(600);
  }
}

// ----------------------------------------------------------------
//  Truffle hunt (180 frames, 9 s) — every 30-60 s: sniff around
//  ("?", then "!"), root with the snout while dirt flies (a hole
//  opens, a mound grows), the truffle rises out of the hole and pops
//  up sparkling, happy hop, three bites with crumbs, then a heart.
// ----------------------------------------------------------------
static const int DIG_LEN = 180;
static const uint8_t DIG_POP[12]    = {2, 5, 7, 9, 10, 10, 9, 7, 5, 3, 1, 0};
static const uint8_t DIG_BOUNCE[4]  = {1, 2, 1, 0};
static const uint8_t DIG_HOP[6]     = {0, 2, 4, 5, 4, 2};

struct DigStep {
  uint8_t frame;
  uint8_t truffle;      // 0 none, 1 whole, 2 one bite, 3 two bites, 4 crumbs
  uint8_t lift, reveal, dy, mound;
  char    mark;
  bool    dirt, hole, sparkle, crumbs, heart;
};

static DigStep digAt(int k) {
  DigStep d = {};
  d.frame = PF_STAND;
  if (k < 6) return d;
  if (k < 22) { d.frame = (((k - 6) >> 2) & 1) ? PF_SNIFF2 : PF_SNIFF1; if (k >= 14) d.mark = '?'; return d; }
  if (k < 28) { d.mark = '!'; return d; }
  if (k < 76) {
    d.frame = ((k >> 1) & 1) ? PF_SNIFF2 : PF_SNIFF1;
    d.dirt  = (k % 2 == 0);
    d.hole  = (k == 30);
    d.mound = k == 40 ? 1 : k == 54 ? 2 : k == 68 ? 3 : 0;
    return d;
  }
  if (k < 88)  { d.truffle = 1; d.reveal = 1 + (k - 76) / 3; return d; }
  if (k < 100) { d.truffle = 1; d.lift = DIG_POP[k - 88]; d.sparkle = true; d.mark = '!'; return d; }
  if (k < 112) {
    int j = k - 100;
    d.frame = PF_HAPPY; d.truffle = 1;
    d.lift = j < 4 ? DIG_BOUNCE[j] : 0;
    d.dy   = j < 6 ? DIG_HOP[j] : 0;
    d.sparkle = j < 8;
    return d;
  }
  if (k < 118) { d.truffle = 1; return d; }
  if (k < 154) {
    int b = (k - 118) / 12, j = (k - 118) % 12;
    d.frame   = j < 4 ? PF_SNIFF2 : j < 8 ? PF_SNIFF1 : PF_STAND;
    d.truffle = 1 + b + (j >= 2 ? 1 : 0);
    d.crumbs  = (j == 2);
    return d;
  }
  if (k < 158) { d.truffle = 4; return d; }
  if (k < 176) { d.frame = PF_HAPPY; d.heart = (k == 158); return d; }
  d.frame = PF_BLINK;
  return d;
}

// Dirt and crumb particles
struct Dirt { float x, y, vx, vy; bool live; };
static Dirt dirt[16];

static void spawnDirt(float x, float y, float vx, float vy) {
  for (Dirt& d : dirt) if (!d.live) { d = {x, y, vx, vy, true}; return; }
}

static void dirtTick(int32_t gx) {
  for (Dirt& d : dirt) {
    if (!d.live) continue;
    d.x += d.vx; d.vy += 0.2f; d.y += d.vy;
    int sx = (int)lroundf(d.x);
    if (sx < 0 || sx >= 72 || d.y >= groundAt(sx, gx)) { d.live = false; continue; }
    safePixel(sx, (int)lroundf(d.y));
  }
}

// Hearts that float up from pigs' heads (after a truffle, or one per pig at a party)
struct Heart { bool live; float x, y; int16_t age; };
static Heart hearts[8];

static void addHeart(float x, float y, int delay) {
  for (Heart& h : hearts) if (!h.live) { h = {true, x, y, (int16_t)-delay}; return; }
}

static void heartsTick() {
  for (Heart& h : hearts) {
    if (!h.live) continue;
    if (++h.age > 44) { h.live = false; continue; }
    if (h.age < 1) continue;                 // staggered start
    if (h.age < 34 || h.age % 4 < 2)         // blink out at the end
      blit(HEART, HEART_W, HEART_H, (int)lroundf(h.x + sinf(h.age * 0.3f) * 1.5f),
           (int)lroundf(h.y - h.age / 3.0f), false, 1);
  }
}

// Unique-network count, right-aligned in a cleared box so clouds pass behind it
static void drawCounter(uint32_t n) {
  char buf[12];
  snprintf(buf, sizeof(buf), "%lu", (unsigned long)n);
  int w = strlen(buf) * 4;
  oled.setFont(u8g2_font_4x6_tf);
  oled.setDrawColor(0);
  oled.drawBox(72 - w - 2, 0, w + 2, 7);
  oled.setDrawColor(1);
  oled.drawStr(72 - w - 1, 6, buf);
}

// ----------------------------------------------------------------
//  Channel graph — 14 bars (ch 1-14), 4 px wide + 1 px gap = 70 px.
//  Height = networks in the latest scan of that channel, scaled to
//  the busiest channel. The channel being scanned now is outlined.
// ----------------------------------------------------------------
static void drawGraphPage() {
  const int BAR_W = 4, PITCH = 5, X0 = 1;
  const int TOP = 8, BASE = 33;          // bar area y 8..33 (26 px)
  const int MAX_H = BASE - TOP + 1;

  uint8_t maxN = 0, busiest = 0;
  for (int i = 0; i < 14; i++)
    if (chCount[i] > maxN) { maxN = chCount[i]; busiest = i + 1; }

  char l1[20];
  if (maxN) snprintf(l1, sizeof(l1), "busiest ch%d: %d", busiest, maxN);
  else      snprintf(l1, sizeof(l1), "%s", haveCore ? "scanning..." : "no Core yet");
  oled.setFont(u8g2_font_4x6_tf);
  oled.drawStr(0, 5, l1);

  uint8_t s, e;
  effRange(s, e);
  for (int i = 0; i < 14; i++) {
    int x = X0 + i * PITCH;
    int h = maxN ? (chCount[i] * MAX_H + maxN - 1) / maxN : 0;  // round up so 1 net shows
    bool inRange = haveCore && i >= s && i <= e;
    bool current = haveCore && scanActive && (i + 1) == scanCurCh;

    if (h) {
      if (current) oled.drawFrame(x, BASE - h + 1, BAR_W, h);
      else         oled.drawBox(x, BASE - h + 1, BAR_W, h);
    } else if (current) {
      oled.drawHLine(x, BASE, BAR_W);
    }
    // Baseline tick: solid under assigned channels, single dot otherwise
    if (inRange) oled.drawHLine(x, BASE + 1, BAR_W);
    else         oled.drawPixel(x + 1, BASE + 1);
  }

  // Channel labels under bars 1, 6, 11, 14
  oled.drawStr(X0 + 0 * PITCH,     40, "1");
  oled.drawStr(X0 + 5 * PITCH,     40, "6");
  oled.drawStr(X0 + 10 * PITCH - 2, 40, "11");
  oled.drawStr(X0 + 13 * PITCH - 3, 40, "14");
}

// ----------------------------------------------------------------
//  Pig behaviour, 20 fps. Modes follow the node state:
//    searching  -> sniff, look both ways, "?"
//    linked     -> trot while the world scrolls; stop to sniff, dig
//                  truffles, turn round now and then, hop on each new network
//    idle       -> linked but nothing new for PIG_SLEEP_MS: sleep, "zZ"
// ----------------------------------------------------------------
static const uint32_t PIG_SLEEP_MS = 60000;
static uint32_t lastNewMs = 0;   // last time a never-seen BSSID turned up
static uint32_t lastWakeMs = 0;  // last time something else (a party) woke the pig

// ----------------------------------------------------------------
//  Friends — other Piglet C3 nodes. Each node tags its heartbeat
//  text field (len stays 0, so the Core still sees an empty heartbeat):
//    [0..3] "PIG1"   [4..7] unique networks found   [8..9] party
//    countdown in 100 ms steps (0 = none)   [10] party id
//  Nearby friends join our pig on screen as a flock (up to 6 pigs).
// ----------------------------------------------------------------
static const uint32_t FRIEND_NEAR_MS = 45000;   // nearby if heard within this long
static const int      MAX_FRIENDS    = 6;
static const int      MAX_FLOCK      = 5;       // friends on screen, so 6 pigs with ours

struct Friend {
  bool     used, hopPending;
  uint8_t  mac[6];
  uint32_t firstMs, lastMs, nets;
  uint16_t hellos;
  int8_t   rssi;
};
static Friend  friends[MAX_FRIENDS];
static uint8_t myMac[6];

// Filled in by the ESP-Now callback, consumed by friendsTick() in the main loop
struct FriendMsg { uint8_t mac[6]; int8_t rssi; uint32_t nets; uint16_t partyCd; uint8_t partyId; };
static volatile bool friendPending = false;
static FriendMsg     friendMsg;

// Shared party: the node with the lowest MAC leads and announces a countdown
static uint32_t partyAtMs   = 0;    // when the next party starts (0 = none)
static bool     hostingParty = false;
static uint8_t  partyId     = 0;
static uint32_t nextPartyMs = 0;    // leader: when to announce the next one

static void friendName(const uint8_t* mac, char* out) { snprintf(out, 5, "%02X%02X", mac[4], mac[5]); }
static bool friendNear(const Friend& f) { return f.used && millis() - f.lastMs < FRIEND_NEAR_MS; }

// Leader = lowest MAC among us and the friends we can hear
static bool isLowest(const uint8_t* mac) {
  if (memcmp(mac, myMac, 6) > 0) return false;
  for (const Friend& f : friends)
    if (friendNear(f) && memcmp(f.mac, mac, 6) < 0) return false;
  return true;
}

static void friendsTick() {
  if (!friendPending) return;
  FriendMsg m;
  memcpy(&m, (const void*)&friendMsg, sizeof(m));
  friendPending = false;

  uint32_t now = millis();
  int slot = -1;
  for (int i = 0; i < MAX_FRIENDS; i++)
    if (friends[i].used && memcmp(friends[i].mac, m.mac, 6) == 0) { slot = i; break; }
  if (slot < 0) {                                 // new friend: free slot, else the stalest
    slot = 0;
    for (int i = 0; i < MAX_FRIENDS; i++) {
      if (!friends[i].used) { slot = i; break; }
      if (friends[i].lastMs < friends[slot].lastMs) slot = i;
    }
    friends[slot] = {};
    friends[slot].used = true;
    friends[slot].firstMs = now;
    memcpy(friends[slot].mac, m.mac, 6);
  }
  Friend& f = friends[slot];
  bool wasNear = f.hellos > 0 && now - f.lastMs < FRIEND_NEAR_MS;
  if (wasNear && m.nets > f.nets) f.hopPending = true;   // its node found a network: its pig hops
  f.nets   = m.nets;
  f.lastMs = now;
  f.rssi   = m.rssi;
  f.hellos++;
  if (!wasNear) {
    char name[5];
    friendName(f.mac, name);
    Serial.printf("[FRIEND] %s nearby (rssi %d)\n", name, m.rssi);
  }
  // Join the leader's party countdown
  if (m.partyCd && m.partyId != partyId && isLowest(m.mac)) {
    partyId      = m.partyId;
    partyAtMs    = now + m.partyCd * 100u;
    hostingParty = false;
  }
}

// ----------------------------------------------------------------
//  Pig sprite sets. The more pigs on screen, the smaller everyone is:
//  1-2 pigs full size, 3-4 medium, 5-6 small.
// ----------------------------------------------------------------
// frames holds PIG_LOOKS sets of PF_COUNT frames (one per spot pattern); masks and edges are shared
struct PigSet { uint8_t w, h; const uint32_t* frames; const uint32_t* masks; const uint32_t* edges; };
static const PigSet SET_L  = {PIGL_W,    PIGL_H,    &PIGL_FRAMES[0][0][0],    &PIGL_MASKS[0][0],    &PIGL_EDGES[0][0]};
static const PigSet SET_FL = {FRIENDL_W, FRIENDL_H, &FRIENDL_FRAMES[0][0][0], &FRIENDL_MASKS[0][0], &FRIENDL_EDGES[0][0]};
static const PigSet SET_M  = {PIGM_W,    PIGM_H,    &PIGM_FRAMES[0][0][0],    &PIGM_MASKS[0][0],    &PIGM_EDGES[0][0]};
static const PigSet SET_S  = {PIGS_W,    PIGS_H,    &PIGS_FRAMES[0][0][0],    &PIGS_MASKS[0][0],    &PIGS_EDGES[0][0]};

// sp = spacing between pigs, lead = gap ahead of the leader, back = rise of the back row
struct FlockSize { const PigSet* own; const PigSet* fr; uint8_t sp, lead; int8_t back; uint8_t jump; };
static const FlockSize SIZE_L = {&SET_L, &SET_FL, 22, 12, -3, 13};
static const FlockSize SIZE_M = {&SET_M, &SET_M,  12, 12, -7, 10};
static const FlockSize SIZE_S = {&SET_S, &SET_S,   9, 10, -6,  8};
static const FlockSize& flockSize(int n) { return n <= 2 ? SIZE_L : n <= 4 ? SIZE_M : SIZE_S; }

// edge = true draws a 1 px black border (not below the hooves) so overlapping pigs stay separate
static void drawPig(const PigSet& s, uint8_t f, int x, int y, bool flip, bool edge, uint8_t look) {
  if (edge) blit(s.edges + f * s.h, s.w + 2, s.h, x - 1, y, flip, 0);
  else      blit(s.masks + f * s.h, s.w, s.h, x, y, flip, 0);
  blit(s.frames + (look * PF_COUNT + f) * s.h, s.w, s.h, x, y, flip, 1);
}

// Each pig's look (spot pattern) comes from a hash of its node's address. If two pigs in the
// flock land on the same look, the one with the higher address takes the next free look.
// Every node sorts the same addresses the same way, so a pig looks the same on every screen.
static uint8_t lookHash(const uint8_t* mac) {
  uint32_t h = 2166136261u;
  for (int i = 0; i < 6; i++) h = (h ^ mac[i]) * 16777619u;
  return h % PIG_LOOKS;
}
static void assignLooks(const uint8_t* const* macs, uint8_t* looks, int n) {
  int order[6];
  for (int i = 0; i < n; i++) order[i] = i;
  for (int i = 1; i < n; i++)                          // insertion sort by address
    for (int j = i; j > 0 && memcmp(macs[order[j]], macs[order[j - 1]], 6) < 0; j--) {
      int tmp = order[j]; order[j] = order[j - 1]; order[j - 1] = tmp;
    }
  bool taken[PIG_LOOKS] = {false};
  for (int k = 0; k < n; k++) {
    uint8_t v = lookHash(macs[order[k]]);
    while (taken[v]) v = (v + 1) % PIG_LOOKS;
    taken[v] = true;
    looks[order[k]] = v;
  }
}

// Crouch, jump, land — used for our pig and for friends when their node finds a network
static bool hopAt(int k, int jump, uint8_t& f, int& dy) {
  dy = 0;
  if (k < 2)  { f = PF_CROUCH; return true; }
  if (k < 14) { int i = k - 2; f = PF_JUMP; dy = (int)lroundf(i * (11 - i) / 30.25f * jump); return true; }
  if (k < 16) { f = PF_LAND; return true; }
  return false;
}

// Party: everyone jumps together. 2 pigs: one jump + hearts. 3-4: two jumps + confetti.
// 5-6: three jumps + confetti + fireworks.
static int partyJumps(int n) { return n <= 2 ? 1 : n <= 4 ? 2 : 3; }
static bool partyAt(int k, int n, int jump, uint8_t& f, int& dy, bool& peak, bool& hearts) {
  int J = partyJumps(n);
  peak = hearts = false; dy = 0;
  if (k < J * 20) {
    int j = k % 20;
    if (!hopAt(j, jump, f, dy)) f = PF_HAPPY;
    peak = (j == 7);
    return true;
  }
  if (k < J * 20 + 18) { f = PF_HAPPY; hearts = (k == J * 20); return true; }
  if (k < J * 20 + 24) { f = PF_STAND; return true; }
  return false;
}

// Confetti and fireworks
struct Spark { float x, y, vx, vy, g; uint8_t life; };
static Spark sparks[48];
static void addSpark(float x, float y, float vx, float vy, float g, uint8_t life) {
  for (Spark& s : sparks) if (!s.life) { s = {x, y, vx, vy, g, life}; return; }
}
static void sparksTick(int32_t gx, uint32_t t) {
  for (Spark& s : sparks) {
    if (!s.life) continue;
    s.x += s.vx + sinf((t + s.life) * 0.3f) * 0.2f;
    s.vy += s.g; s.y += s.vy;
    int sx = (int)lroundf(s.x);
    if (--s.life == 0 || sx < 0 || sx >= 72 || s.y >= groundAt(sx, gx)) { s.life = 0; continue; }
    safePixel(sx, (int)lroundf(s.y));
  }
}

// Friends on screen
struct FlockPig { bool used, leaving; int8_t fslot; int x; int16_t hop; uint16_t wt; uint8_t label, look; };
static FlockPig herd[MAX_FLOCK];

enum PigMode : uint8_t { PM_SEARCH, PM_TROT, PM_SLEEP };
enum PigAct  : uint8_t { PA_WALK, PA_HOP, PA_SNIFF, PA_TURN, PA_DIG };

// ----------------------------------------------------------------
//  Stats page — four panels that rotate every 4 s: NODE, NETWORKS,
//  FLOCK, AIR. Title bar is lit, with a dot per panel on the right.
// ----------------------------------------------------------------
static void fmtDur(uint32_t ms, char* out, size_t n) {
  uint32_t s = ms / 1000;
  if (s < 60)         snprintf(out, n, "%lus", (unsigned long)s);
  else if (s < 3600)  snprintf(out, n, "%lum%02lus", (unsigned long)(s / 60), (unsigned long)(s % 60));
  else if (s < 86400) snprintf(out, n, "%luh%02lum", (unsigned long)(s / 3600), (unsigned long)(s / 60 % 60));
  else                snprintf(out, n, "%lud%02luh", (unsigned long)(s / 86400), (unsigned long)(s / 3600 % 24));
}

static void drawStatsPage() {
  static const int PANELS = 4;
  int panel = (millis() / 4000) % PANELS;
  char l[6][20] = {};
  char d[12];

  if (panel == 0) {                                   // --- NODE ---
    snprintf(l[0], 20, "PIGLET %02X%02X", myMac[4], myMac[5]);
    snprintf(l[1], 20, "fw %s", FIRMWARE_VERSION);
    fmtDur(millis(), d, sizeof(d));
    snprintf(l[2], 20, "up %s", d);
    if (haveCore) {
      uint8_t s, e;
      effRange(s, e);
      snprintf(l[3], 20, "core %02X%02X ch%d-%d", coreMac[4], coreMac[5], CHANNELS[s], CHANNELS[e]);
      fmtDur(millis() - linkedMs, d, sizeof(d));
      snprintf(l[4], 20, "linked %s", d);
    } else {
      snprintf(l[3], 20, "core: searching");
      snprintf(l[4], 20, "ask every %lus", (unsigned long)(reqInterval / 1000 ? reqInterval / 1000 : 1));
    }
    snprintf(l[5], 20, "heap %luk", (unsigned long)(ESP.getFreeHeap() / 1024));
  } else if (panel == 1) {                            // --- NETWORKS ---
    snprintf(l[0], 20, "NETWORKS");
    uint32_t mins = haveCore ? (millis() - linkedMs) / 60000 : 0;
    if (mins >= 5) snprintf(l[1], 20, "unique %lu +%lu/h", (unsigned long)netNew, (unsigned long)(netNew * 60 / mins));
    else           snprintf(l[1], 20, "unique %lu", (unsigned long)netNew);
    snprintf(l[2], 20, "seen %lu ble %lu", (unsigned long)netFound, (unsigned long)bleNew);
    snprintf(l[3], 20, "sent %lu", (unsigned long)netSent);
    snprintf(l[4], 20, "open %lu wep %lu eap %lu", (unsigned long)authCount[AK_OPEN],
             (unsigned long)authCount[AK_WEP], (unsigned long)authCount[AK_EAP]);
    snprintf(l[5], 20, "wpa2 %lu wpa3 %lu", (unsigned long)authCount[AK_WPA2], (unsigned long)authCount[AK_WPA3]);
  } else if (panel == 2) {                            // --- FLOCK ---
    int near = 0;
    for (const Friend& f : friends) if (friendNear(f)) near++;
    snprintf(l[0], 20, "FLOCK %d PIG%s%s", near + 1, near ? "S" : "", near && isLowest(myMac) ? " *" : "");
    int row = 1;
    for (const Friend& f : friends) {
      if (!friendNear(f) || row > 4) continue;
      char name[5];
      friendName(f.mac, name);
      fmtDur(millis() - f.lastMs, d, sizeof(d));
      snprintf(l[row++], 20, "%s %d %s n%lu", name, f.rssi, d, (unsigned long)f.nets);
    }
    if (!near) snprintf(l[1], 20, "no friends nearby");
    snprintf(l[5], 20, "parties %lu", (unsigned long)partiesSeen);
  } else {                                            // --- AIR ---
    snprintf(l[0], 20, "AIR");
    if (!haveCore)         snprintf(l[1], 20, "on ch%d (home)", ESPNOW_CH);
    else if (scanAdminWin) snprintf(l[1], 20, "on ch%d (core)", ESPNOW_CH);
    else                   snprintf(l[1], 20, "scanning ch%d", scanCurCh);
    uint8_t maxN = 0, busiest = 0;
    for (int i = 0; i < 14; i++) if (chCount[i] > maxN) { maxN = chCount[i]; busiest = i + 1; }
    if (maxN) snprintf(l[2], 20, "busiest ch%d (%d)", busiest, maxN);
    else      snprintf(l[2], 20, "busiest: -");
    if (bestMs) {
      snprintf(l[3], 20, "best %ddBm ch%d", bestRssi, bestCh);
      snprintf(l[4], 20, "%s", bestSsid);
    } else snprintf(l[3], 20, "best: -");
    if (lastNewMs && netNew) { fmtDur(millis() - lastNewMs, d, sizeof(d)); snprintf(l[5], 20, "new %s ago", d); }
    else snprintf(l[5], 20, "no networks yet");
  }

  oled.setFont(u8g2_font_4x6_tf);
  oled.setFontMode(1);
  oled.drawBox(0, 0, 72, 7);                          // lit title bar
  oled.setDrawColor(0);
  oled.drawStr(1, 6, l[0]);
  for (int i = 0; i < PANELS; i++) {                  // panel dots: 2x2 = current, 1x1 = others
    int dx = 71 - (PANELS - i) * 4;
    if (i == panel) oled.drawBox(dx, 2, 2, 3);
    else            oled.drawPixel(dx, 3);
  }
  oled.setDrawColor(1);
  for (int i = 1; i < 6; i++) oled.drawStr(0, 7 + i * 6, l[i]);
  oled.setFontMode(0);
}

static void oledTick() {
  static uint32_t lastMs = 0;
  if (millis() - lastMs < 50) return;
  lastMs = millis();

  if (oledPage == PAGE_GRAPH || oledPage == PAGE_STATS) {
    hopPending = false;  // don't queue a stale hop for when we flip back
    oled.clearBuffer();
    if (oledPage == PAGE_GRAPH) drawGraphPage();
    else                        drawStatsPage();
    oled.sendBuffer();
    return;
  }

  static uint32_t t = 0, nextJoin = 0;
  static uint8_t  lastMode = 0xFF;
  static int      x = 14, dir = 1, lastN = 1;
  static int32_t  gx = 0;                  // ground scroll
  static uint8_t  act = PA_WALK;
  static uint16_t actT = 0, walkT = 0;
  static uint32_t nextSniff = 0, nextTurn = 0, nextDig = 0;
  static int      pigY = GROUND_BASE - PIGL_H;   // follows the ground under the hooves
  static bool     partyOn = false;
  static uint16_t partyK = 0;
  uint32_t now = millis();

  // --- flock bookkeeping: friends join from behind one at a time and leave the same way ---
  int n = 1;
  for (const FlockPig& p : herd) if (p.used && !p.leaving) n++;
  for (int i = 0; i < MAX_FRIENDS; i++) {
    int k = -1;
    for (int j = 0; j < MAX_FLOCK; j++) if (herd[j].used && herd[j].fslot == i) k = j;
    bool near = friendNear(friends[i]);
    if (near && k < 0 && n - 1 < MAX_FLOCK && t >= nextJoin) {
      for (FlockPig& p : herd) if (!p.used) {
        p = {true, false, (int8_t)i, dir > 0 ? -40 : 80, -1, (uint16_t)rnd(8), 70, 0};
        n++; nextJoin = t + 25;
        break;
      }
    } else if (!near && k >= 0 && !herd[k].leaving) {
      herd[k].leaving = true; herd[k].label = 0; n--;
    }
    if (k >= 0 && friends[i].hopPending) { friends[i].hopPending = false; if (herd[k].hop < 0) herd[k].hop = 0; }
  }
  const FlockSize& sz = flockSize(n);
  const PigSet& P = *sz.own;

  // Looks: us plus every friend pig on screen (leaving pigs keep the look they had)
  static uint8_t ownLook = 0;
  {
    const uint8_t* macs[1 + MAX_FLOCK];
    uint8_t looks[1 + MAX_FLOCK];
    FlockPig* who[1 + MAX_FLOCK];
    int m = 0;
    macs[m] = myMac; who[m++] = nullptr;
    for (FlockPig& p : herd) if (p.used && !p.leaving) { macs[m] = friends[p.fslot].mac; who[m++] = &p; }
    assignLooks(macs, looks, m);
    ownLook = looks[0];
    for (int k = 1; k < m; k++) who[k]->look = looks[k];
  }
  const int W = P.w;

  // --- shared party: the leader announces it 8 s ahead in its heartbeat ---
  if (n >= 2 && isLowest(myMac)) {
    if (n > lastN && !partyAtMs && (int32_t)(nextPartyMs - (now + 4000)) > 0) nextPartyMs = now + 4000;  // flock grew
    if (!partyAtMs && (int32_t)(now - nextPartyMs) >= 0) {
      partyAtMs = now + 8000; partyId++; hostingParty = true;
      nextPartyMs = partyAtMs + 180000 + rnd(120000);
    }
  }
  lastN = n;
  if (partyAtMs && (int32_t)(now - partyAtMs) >= 0) {
    partyAtMs = 0; hostingParty = false;
    if (haveCore && n >= 2) { partyOn = true; partyK = 0; act = PA_WALK; lastWakeMs = now; partiesSeen++; }
  }

  uint8_t mode = !haveCore ? PM_SEARCH
               : (!partyOn && now - max(lastNewMs, lastWakeMs) > PIG_SLEEP_MS && !hopPending) ? PM_SLEEP
               : PM_TROT;
  if (mode != lastMode) {
    lastMode = mode; t = 0; nextJoin = 0; act = PA_WALK; actT = 0; dir = 1;
    if (mode != PM_TROT) partyOn = false;
    x = (mode == PM_TROT) ? 14 : (72 - W) / 2;
    nextSniff = 120 + rnd(80);
    nextTurn  = 300 + rnd(200);
    nextDig   = 600 + rnd(600);
  }
  t++;

  uint8_t f = PF_STAND, pf = PF_STAND;
  int dy = 0, pdy = 0, scroll = 0;
  char mark = 0;
  bool digging = false, partyFrame = false;
  DigStep ds = {};

  if (mode == PM_SEARCH) {
    hopPending = false;
    uint32_t p = t % 96;
    if (p < 16 || (p >= 48 && p < 64)) f = ((p >> 2) & 1) ? PF_SNIFF2 : PF_SNIFF1;
    else if ((p >= 16 && p < 20) || (p >= 64 && p < 68)) {
      f = PF_TURN;
      if (p == 19 || p == 67) dir = -dir;
    } else {
      f = (p == 30 || p == 31 || p == 80 || p == 81) ? PF_BLINK : PF_STAND;
      mark = '?';
    }
  } else if (mode == PM_SLEEP) {
    f = ((t / 24) & 1) ? PF_SLEEP2 : PF_SLEEP1;
  } else if (partyOn) {
    bool peak, hearts;
    if (!partyAt(partyK++, n, sz.jump, pf, pdy, peak, hearts)) partyOn = false;
    else {
      partyFrame = true; f = pf; dy = pdy;
      if (peak && n >= 5) {                                  // firework burst
        float cx = 10 + rnd(52), cy = 4 + rnd(10);
        for (int i = 0; i < 10; i++) {
          float a = i * 3.14159f / 5;
          addSpark(cx, cy, cosf(a) * 1.1f, sinf(a) * 1.1f, 0.04f, 12);
        }
      }
      if (hearts) {
        addHeart(dir > 0 ? x + W - 9 : x + 3, pigY - 6, 0);
        for (const FlockPig& p : herd)
          if (p.used && !p.leaving) addHeart(p.x + sz.fr->w / 2 - 2, pigY - 6, rnd(8));
      }
    }
  } else {
    if (act == PA_WALK) {
      if (hopPending) act = PA_HOP;
      else if (t >= nextDig) {
        // Only dig on open ground; if a tree is in the way, keep walking and retry in 1 s
        int32_t a = gx + (dir > 0 ? x + W - 4 : x - 22);
        int32_t b = gx + (dir > 0 ? x + W + 22 : x + 4);
        if (treeBetween(a, b)) nextDig = t + 20;
        else { act = PA_DIG; nextDig = t + DIG_LEN + 600 + rnd(600); }
      }
      else if (t >= nextTurn)  { act = PA_TURN;  nextTurn  = t + 300 + rnd(300); }
      else if (t >= nextSniff) { act = PA_SNIFF; nextSniff = t + 160 + rnd(120); }
      actT = 0;
      hopPending = false;
    }
    switch (act) {
      case PA_HOP:                          // crouch, jump, land, happy
        if (actT < 16) { hopAt(actT, sz.jump, f, dy); if (actT >= 2 && actT < 14) { scroll = 2; mark = '!'; } }
        else if (actT < 26) f = PF_HAPPY;
        else if (actT < 28) f = PF_STAND;
        else act = PA_WALK;
        break;
      case PA_SNIFF:                        // stop, nose down four times, blink
        if      (actT < 3)  f = PF_STAND;
        else if (actT < 35) f = (((actT - 3) >> 2) & 1) ? PF_SNIFF2 : PF_SNIFF1;
        else if (actT < 39) f = PF_STAND;
        else if (actT < 41) f = PF_BLINK;
        else if (actT < 47) f = PF_STAND;
        else act = PA_WALK;
        break;
      case PA_TURN:                         // face the viewer, then walk the other way
        if      (actT < 3)  f = PF_STAND;
        else if (actT < 7)  f = PF_TURN;
        else if (actT == 7) { f = PF_TURN; dir = -dir; }
        else if (actT < 10) f = PF_STAND;
        else act = PA_WALK;
        break;
      case PA_DIG:
        if (actT < DIG_LEN) {
          ds = digAt(actT); digging = true;
          f = ds.frame; dy = ds.dy; mark = ds.mark;
        } else act = PA_WALK;
        break;
      default: break;
    }
    if (act == PA_WALK) {
      walkT++;
      f = PF_WALK1 + ((walkT >> 1) & 3);
      scroll = 1;
    } else {
      actT++;
    }
  }
  gx += scroll * dir;
  if (!scroll && t % 1200 == 0) gx += dir;   // creep 1 px a minute while standing (burn-in)

  // Formation: slot 0 is our pig in front; friends trail behind, alternating back/front rows
  auto slotX = [&](int i) {
    if (n < 2) return dir > 0 ? 14 : 72 - W - 14;
    int lead = dir > 0 ? 72 - W - sz.lead : sz.lead;
    return lead - dir * sz.sp * i;
  };
  auto standY = [&](int px, const PigSet& s) {
    int top = 99;
    for (int sx = px + 4; sx <= px + s.w - 6; sx++) top = min(top, groundAt(sx, gx));
    return top - s.h;
  };

  // Our pig drifts to its slot while walking (quickly when the flock is reshuffling)
  int tx = slotX(0);
  if (x != tx && (scroll || (n >= 2 && f == PF_STAND && !digging)) && (n >= 2 || t % 5 == 0))
    x += (tx > x) ? 1 : -1;
  int want = standY(x, P);
  if (abs(pigY - want) > 3) pigY = want;
  else if ((t & 1) == 0 && pigY != want) pigY += (want > pigY) ? 1 : -1;
  const int PIG_Y = pigY;

  // Dig site sits just past the snout, with the mound beyond it
  int tsx = dir > 0 ? x + W + 1 : x - 8;
  if (digging && ds.hole)  site = {true, tsx + gx, tsx + gx + (dir > 0 ? 8 : -10), 0};
  if (digging && ds.mound && site.active) site.mound = ds.mound;

  oled.clearBuffer();
  drawWorld(gx, scroll * dir);
  butterflyTick(scroll * dir);               // behind the pigs: their masks hide it as it passes

  // Friends: walk to their slot, hop when their node finds a network, copy the flock's turn/sleep/party.
  // Back row (odd slots) first, then the front row, so nearer pigs overlap farther ones.
  const PigSet& FS = *sz.fr;
  for (int pass = 0; pass < 2; pass++) {
    int idx = 0;
    for (FlockPig& p : herd) {
      if (!p.used) continue;
      int i = p.leaving ? 9 : ++idx;
      if ((i % 2 == 1) != (pass == 0)) continue;
      int target = p.leaving ? (dir > 0 ? -FS.w - 12 : 84) : slotX(i);
      bool moving = p.x != target;
      if (moving) {
        int step = (p.leaving || abs(target - p.x) > 20) ? 2 : 1;
        p.x += (target > p.x) ? min(step, target - p.x) : -min(step, p.x - target);
      }
      if (p.leaving && p.x == target) { p.used = false; continue; }

      uint8_t ff = PF_STAND;
      int fdy = 0;
      if (partyFrame)            { ff = pf; fdy = pdy; }
      else if (mode == PM_SLEEP) ff = (((t + i * 7) / 24) & 1) ? PF_SLEEP2 : PF_SLEEP1;
      else if (p.hop >= 0)       { if (!hopAt(p.hop++, sz.jump, ff, fdy)) { p.hop = -1; ff = PF_STAND; } }
      else if (moving || scroll) { p.wt++; ff = PF_WALK1 + ((p.wt >> 1) & 3); }
      else if (f == PF_TURN)     ff = PF_TURN;
      else if (mode == PM_SEARCH) ff = (((t + i * 5) >> 2) % 4 == 0) ? PF_SNIFF1 : PF_STAND;
      else                       ff = ((t + i * 37) % 90 < 2) ? PF_BLINK : PF_STAND;
      if (p.label) p.label--;

      bool faceR = p.leaving ? target > p.x : dir > 0;
      int  fy = standY(p.x, FS) + ((i % 2) ? sz.back : 0) - fdy;
      drawPig(FS, ff, p.x, fy, !faceR && ff != PF_TURN, true, p.look);
      if (p.label && n <= 4) {
        char name[5];
        friendName(friends[p.fslot].mac, name);
        oled.setFont(u8g2_font_4x6_tf);
        oled.drawStr(p.x + FS.w / 2 - 8, fy - 1, name);
      }
    }
  }
  drawPig(P, f, x, PIG_Y - dy, dir < 0 && f != PF_TURN, n >= 2, ownLook);

  if (digging) {
    int gy = groundAt(tsx + 3, gx);
    int snx = dir > 0 ? x + W : x - 1;
    if (ds.dirt)
      for (int k = 0; k < 2; k++)
        spawnDirt(snx, gy - 1, dir * (0.3f + rndf() * 1.6f) * (rnd(4) ? 1 : -1), -1.2f - rndf() * 1.8f);
    if (ds.crumbs)
      for (int k = 0; k < 3; k++) spawnDirt(tsx + 3, gy - 4, (rndf() - 0.5f) * 2, -0.8f - rndf());
    if (ds.truffle) {
      static const uint32_t* const TRUF[5] = {nullptr, TRUFFLE, TRUFFLE_BITE1, TRUFFLE_BITE2, TRUFFLE_CRUMBS};
      const uint32_t* g = TRUF[ds.truffle];
      if (ds.reveal) {
        // Rising out of the hole: only the rows above the dip show
        int rows = ds.reveal > TRUFFLE_H ? TRUFFLE_H : ds.reveal;
        blit(g, TRUFFLE_W, rows, tsx, gy + 2 - ds.reveal, false, 1);
      } else {
        blit(g, TRUFFLE_W, TRUFFLE_H, tsx, gy - 6 - ds.lift, false, 1);
      }
      if (ds.sparkle) {
        int ty = gy - 6 - ds.lift;
        bool a = (t >> 2) & 1;
        blit(a ? SPARKLE_PLUS : SPARKLE_X, 3, 3, tsx - 4, ty - 2 + ((t >> 3) & 1), false, 1);
        blit(a ? SPARKLE_X : SPARKLE_PLUS, 3, 3, tsx + 8, ty + 1, false, 1);
      }
    }
    if (ds.heart) addHeart(dir > 0 ? x + W - 9 : x + 3, PIG_Y - dy - 6, 0);
  }
  if (partyOn && n >= 3 && (t & 1) == 0)       // confetti falls through the whole party
    addSpark(rnd(72), -1, (rndf() - 0.5f) * 0.5f, 0.35f + rndf() * 0.35f, 0, 80);
  dirtTick(gx);
  sparksTick(gx, t);
  heartsTick();

  oled.setFont(u8g2_font_4x6_tf);
  if (mark == '!') {
    int hx = (dir > 0) ? x + W - 9 : x + 3;
    oled.drawStr(hx + 2, PIG_Y - dy - 1, "!");
  } else if (mark == '?' && ((t >> 3) & 1) == 0) {
    oled.drawStr(dir > 0 ? x + W + 1 : x - 4, PIG_Y + 7, "?");
  }
  if (mode == PM_SLEEP) {
    for (int k = 0; k < 3; k++) {
      uint32_t ph = (t + k * 26) % 78;
      if (ph > 64) continue;
      int zx = x + W - 6 + ph / 9 + (k & 1);
      int zy = PIG_Y + 2 - (int)(ph / 4);
      oled.drawStr(zx, zy + 6, ph > 40 ? "Z" : "z");
    }
  }
  drawCounter(netNew);
  if (n > 1) {                               // heart + friend count, top left
    char buf[4];
    snprintf(buf, sizeof(buf), "%d", n - 1);
    oled.setDrawColor(0);
    oled.drawBox(0, 0, 13, 7);
    blit(HEART, HEART_W, HEART_H, 1, 1, false, 1);
    oled.drawStr(8, 6, buf);
  }
  oled.sendBuffer();
}

// ================================================================
//  ESP-Now / WiFi helpers
// ================================================================
static void setChannel(uint8_t ch) {
  esp_wifi_set_ps(WIFI_PS_NONE);
  // Do NOT use promiscuous mode: on IDF 5.x, disabling promiscuous after
  // a prior STA connection causes the driver to revert to the home router channel.
  esp_wifi_set_channel(ch, WIFI_SECOND_CHAN_NONE);
}

static void addPeer(const uint8_t* mac) {
  if (esp_now_is_peer_exist(mac)) esp_now_del_peer(mac);
  esp_now_peer_info_t peer = {};
  memcpy(peer.peer_addr, mac, 6);
  peer.channel = 0;
  peer.encrypt = false;
  esp_now_add_peer(&peer);
}

static void sendRequest() {
  jcmk_text_msg_t msg = {};
  memcpy(msg.magic, JCMK_MAGIC, 4);
  msg.type = MSG_CORE_REQUEST;
  esp_now_send(JCMK_BCAST, (uint8_t*)&msg, sizeof(msg));
}

static void sendHeartbeat() {
  jcmk_text_msg_t msg = {};
  memcpy(msg.magic, JCMK_MAGIC, 4);
  msg.type    = MSG_HEARTBEAT;
  msg.counter = ++hbCounter;
  // Friend payload for other Piglet C3 nodes; len stays 0 so the Core ignores it
  memcpy(msg.text, "PIG1", 4);
  memcpy(msg.text + 4, &netNew, 4);
  uint16_t cd = 0;
  if (hostingParty && partyAtMs) {
    int32_t left = (int32_t)(partyAtMs - millis());
    cd = left > 0 ? (uint16_t)(left / 100) : 0;
  }
  memcpy(msg.text + 8, &cd, 2);
  msg.text[10] = (char)partyId;
  esp_now_send(JCMK_BCAST, (uint8_t*)&msg, sizeof(msg));
}

static void sendText(const String& s) {
  jcmk_text_msg_t msg = {};
  memcpy(msg.magic, JCMK_MAGIC, 4);
  msg.type    = MSG_TEXT;
  msg.counter = hbCounter;
  uint16_t slen = (uint16_t)((s.length() < JCMK_TEXT_MAX) ? s.length() : JCMK_TEXT_MAX);
  msg.len = slen;
  memcpy(msg.text, s.c_str(), slen);
  msg.text[slen] = '\0';
  // Always full struct size — Biscuit Pro drops packets < 212 bytes.
  esp_now_send(JCMK_BCAST, (uint8_t*)&msg, sizeof(msg));
}

static String authStr(wifi_auth_mode_t m) {
  switch (m) {
    case WIFI_AUTH_OPEN:            return "OPEN";
    case WIFI_AUTH_WEP:             return "WEP";
    case WIFI_AUTH_WPA_PSK:         return "WPA";
    case WIFI_AUTH_WPA2_PSK:        return "WPA2";
    case WIFI_AUTH_WPA_WPA2_PSK:    return "WPAWPA2";
    case WIFI_AUTH_WPA2_ENTERPRISE: return "WPA2EAP";
    case WIFI_AUTH_WPA3_PSK:        return "WPA3";
    case WIFI_AUTH_WPA2_WPA3_PSK:   return "WPA2WPA3";
    default:                        return "UNKNOWN";
  }
}

// ================================================================
//  ESP-Now receive callback (runs in WiFi task — keep minimal)
// ================================================================
static void onRecv(const esp_now_recv_info_t* info, const uint8_t* data, int len) {
  if (len < 5) return;
  if (data[0]!='E' || data[1]!='N' || data[2]!='O' || data[3]!='W') return;
  uint8_t type = data[4];

  if (type == MSG_CORE_REPLY && !haveCore && !coreFoundPending) {
    memcpy(coreMacPending, info->src_addr, 6);
    coreFoundPending = true;

  } else if (type == MSG_ADMIN && len >= (int)sizeof(jcmk_admin_msg_t)) {
    // ---- JCMK binary admin (Piglet Core, JCMK Core) ----
    // Only update if the assignment version has advanced (prevents stale replays).
    const jcmk_admin_msg_t* adm = (const jcmk_admin_msg_t*)data;
    if (adm->assignment_version != assignVer) {
      assignVer = adm->assignment_version;
      startIdx  = adm->start_channel_idx;
      endIdx    = adm->end_channel_idx;
    }
    lastAdminMs = millis();

  } else if (type == 10 && len >= 11) {
    // ---- Biscuit MSG_CONFIG_UPDATE (type 10) ----
    // Payload: jcmk_text_msg_t with text = "channels=1,2,...;dwell=N"
    const jcmk_text_msg_t* tm = (const jcmk_text_msg_t*)data;
    uint16_t slen = (tm->len < JCMK_TEXT_MAX) ? tm->len : JCMK_TEXT_MAX;
    char buf[JCMK_TEXT_MAX + 1];
    memcpy(buf, tm->text, slen);
    buf[slen] = '\0';

    const char* chStart = strstr(buf, "channels=");
    if (chStart) {
      chStart += 9;  // skip "channels="
      uint8_t first = 0xFF, last = 0xFF;
      const char* p = chStart;
      while (*p && *p != ';') {
        int ch = atoi(p);
        for (uint8_t i = 0; i < NUM_CHANNELS; i++) {
          if (CHANNELS[i] == (uint8_t)ch) {
            if (first == 0xFF) first = i;
            last = i;
            break;
          }
        }
        while (*p && *p != ',' && *p != ';') p++;
        if (*p == ',') p++;
      }
      if (first != 0xFF) {
        startIdx  = first;
        endIdx    = last;
        assignVer = (assignVer == 255) ? 1 : assignVer + 1;  // mark as assigned
      }
    }
    lastAdminMs = millis();

  } else if (type == MSG_HEARTBEAT) {
    if (haveCore && memcmp(info->src_addr, coreMac, 6) == 0) {
      // Core is still alive — reset timeout. Other nodes' heartbeats must not count.
      lastAdminMs = millis();
    } else if (len >= (int)offsetof(jcmk_text_msg_t, text) + 11 &&
               memcmp(((const jcmk_text_msg_t*)data)->text, "PIG1", 4) == 0 && !friendPending) {
      // Another Piglet C3 node: hand it to friendsTick() in the main loop
      const char* p = ((const jcmk_text_msg_t*)data)->text;
      memcpy(friendMsg.mac, info->src_addr, 6);
      friendMsg.rssi = info->rx_ctrl ? info->rx_ctrl->rssi : 0;
      memcpy((void*)&friendMsg.nets, p + 4, 4);
      memcpy((void*)&friendMsg.partyCd, p + 8, 2);
      friendMsg.partyId = (uint8_t)p[10];
      friendPending = true;
    }
  }
}

// ================================================================
//  Re-enter searching state (called on boot and on Core timeout)
// ================================================================
static void resetToSearching() {
  haveCore     = false;
  assignVer    = 0;
  startIdx     = 0;
  endIdx       = NUM_CHANNELS - 1;
  hbCounter    = 0;
  lastHbMs     = 0;
  lastReqMs    = 0;
  reqInterval  = REQ_INIT_MS;
  lastAdminMs  = 0;
  scanActive   = false;
  scanChOffset = 0;
  scanAdminWin = false;
  if (bleBusy()) bleScan->stop();
  bleQHead = bleQTail;  // drop unsent BLE hits (no Core to send them to)
  memset(coreMac, 0, 6);
  coreFoundPending = false;

  setChannel(ESPNOW_CH);
  Serial.println("[NODE] Searching for Core on ch 6...");
}

// Send queued BLE hits to the Core (radio must be on ch 6), new addresses only
static void bleDrain() {
  while (bleQHead != bleQTail) {
    BleHit& e = bleQ[bleQHead];
    if (bleMarkSeen(e.addr)) {
      bleNew++;
      sendText(String(e.mac) + "," + e.name + ",[BLE],0," + String(e.rssi) + ",B");
      netSent++;
    }
    bleQHead = (bleQHead + 1) % BLE_Q;
  }
}

// ================================================================
//  Per-channel async scan tick (2.4 GHz only)
// ================================================================
static void scanTick() {
  uint8_t s, e;
  effRange(s, e);
  uint8_t numCh = e - s + 1;

  // Admin window: radio is on ch 6. A BLE scan runs alongside it; the window
  // stays open until the BLE scan has finished and its results are sent.
  if (scanAdminWin) {
    bleDrain();
    if ((int32_t)(millis() - scanAdminMs) >= (int32_t)ADMIN_WIN_MS && !bleBusy()) {
      bleDrain();
      scanAdminWin = false;
      scanChOffset = 0;  // begin next cycle
    }
    return;
  }

  if (!scanActive) {
    // Full cycle done — hop to ch 6, heartbeat, then wait admin window
    if (scanChOffset >= numCh) {
      setChannel(ESPNOW_CH);
      sendHeartbeat();
      lastHbMs     = millis();
      scanAdminWin = true;
      // Random jitter (0-200 ms) staggers admin windows across nodes
      scanAdminMs  = millis() + (uint32_t)(esp_random() % 200);
      if (bleScan) bleScan->start(BLE_SCAN_MS, false, true);  // non-blocking
      return;
    }

    uint8_t channel = CHANNELS[s + scanChOffset];
    int16_t rc = WiFi.scanNetworks(/*async*/true, /*hidden*/true,
                                   /*passive*/false, SCAN_DWELL_MS, channel);
    if (rc == WIFI_SCAN_RUNNING || rc == 0) {
      scanActive = true;
      scanCurCh  = channel;
    } else {
      scanChOffset++;  // channel failed — skip it
    }
    return;
  }

  // Poll for scan completion
  int n = WiFi.scanComplete();
  if (n == WIFI_SCAN_RUNNING) return;

  if (n >= 0 && scanCurCh >= 1 && scanCurCh <= 14)
    chCount[scanCurCh - 1] = (n > 255) ? 255 : (uint8_t)n;

  if (n > 0) {
    netFound += (uint32_t)n;
    // Return to ch 6 before sending (Core only listens on ch 6)
    setChannel(ESPNOW_CH);
    for (int i = 0; i < n; i++) {
      wifi_auth_mode_t am = WiFi.encryptionType(i);
      if (markSeen(WiFi.BSSID(i))) {
        netNew++; hopPending = true; lastNewMs = millis();
        switch (am) {
          case WIFI_AUTH_OPEN:            authCount[AK_OPEN]++; break;
          case WIFI_AUTH_WEP:             authCount[AK_WEP]++;  break;
          case WIFI_AUTH_WPA3_PSK:
          case WIFI_AUTH_WPA2_WPA3_PSK:   authCount[AK_WPA3]++; break;
          case WIFI_AUTH_WPA2_ENTERPRISE: authCount[AK_EAP]++;  break;
          default:                        authCount[AK_WPA2]++; break;
        }
      }
      // Strongest network: replace if louder, or if the old record is over a minute stale
      int8_t rssi = WiFi.RSSI(i);
      if (rssi > bestRssi || millis() - bestMs > 60000) {
        bestRssi = rssi; bestCh = WiFi.channel(i); bestMs = millis();
        String ss = WiFi.SSID(i);
        snprintf(bestSsid, sizeof(bestSsid), "%s", ss.length() ? ss.c_str() : "(hidden)");
      }
      String line = WiFi.BSSIDstr(i) + "," + WiFi.SSID(i) + ","
                  + authStr(WiFi.encryptionType(i)) + ","
                  + String(WiFi.channel(i)) + "," + String(WiFi.RSSI(i)) + ",W";
      sendText(line);
      netSent++;
    }
  }
  WiFi.scanDelete();
  scanActive = false;
  scanChOffset++;
}

// ================================================================
//  Main node tick — call every loop()
// ================================================================
static void nodeTick() {
  if (!nodeActive) return;
  uint32_t now = millis();

  // --- Consume pending core-found event from callback ---
  if (coreFoundPending) {
    coreFoundPending = false;
    memcpy(coreMac, coreMacPending, 6);
    haveCore    = true;
    reqInterval = REQ_INIT_MS;
    lastAdminMs = now;
    lastNewMs   = now;  // start awake, not asleep, after linking
    linkedMs    = now;
    addPeer(coreMac);
    Serial.printf("[NODE] Core found: %02X:%02X:%02X:%02X:%02X:%02X\n",
      coreMac[0], coreMac[1], coreMac[2], coreMac[3], coreMac[4], coreMac[5]);
  }

  // --- Core timeout: re-search if ADMIN/HB silent for CORE_TIMEOUT_MS ---
  if (haveCore && lastAdminMs > 0 && (now - lastAdminMs) >= CORE_TIMEOUT_MS) {
    Serial.println("[NODE] Core timed out — re-searching...");
    WiFi.scanDelete();
    resetToSearching();
    return;
  }

  // --- CORE_REQUEST with exponential backoff (only when radio is free) ---
  if (!haveCore && !scanActive && (now - lastReqMs >= reqInterval)) {
    lastReqMs  = now;
    setChannel(ESPNOW_CH);
    sendRequest();
    reqInterval = (reqInterval * 2 > REQ_MAX_MS) ? REQ_MAX_MS : reqInterval * 2;
  }

  // --- Heartbeat backup (fires if scan stalls) ---
  if (haveCore && !scanActive && (now - lastHbMs >= HB_MS)) {
    lastHbMs = now;
    setChannel(ESPNOW_CH);
    sendHeartbeat();
  }

  // --- Channel scan (runs continuously once paired) ---
  if (haveCore) scanTick();
}

// ================================================================
//  Periodic serial status (every 10 s)
// ================================================================
static void statusTick() {
  static uint32_t lastMs = 0;
  if (millis() - lastMs < 10000) return;
  lastMs = millis();

  if (!haveCore) {
    Serial.printf("[NODE] Searching... (req interval %lu ms)\n",
                  (unsigned long)reqInterval);
  } else {
    uint8_t s, e;
    bool fb = effRange(s, e);
    Serial.printf("[NODE] Core %02X:%02X:%02X:%02X:%02X:%02X | "
                  "assigned ch %d-%d (v%d) | scanning ch %d-%d%s | new %lu | found %lu | ble %lu/%lu | sent %lu\n",
      coreMac[0], coreMac[1], coreMac[2], coreMac[3], coreMac[4], coreMac[5],
      (startIdx < NUM_CHANNELS) ? CHANNELS[startIdx] : 0,
      (endIdx   < NUM_CHANNELS) ? CHANNELS[endIdx]   : 0,
      assignVer, CHANNELS[s], CHANNELS[e],
      fb ? " (5GHz-only assignment, 2.4 fallback)" : "",
      (unsigned long)netNew,
      (unsigned long)netFound,
      (unsigned long)bleNew, (unsigned long)bleSeenTotal,
      (unsigned long)netSent);
  }
  for (const Friend& f : friends) {
    if (!f.used) continue;
    char name[5];
    friendName(f.mac, name);
    Serial.printf("[FRIEND] %s %s | last heard %lus ago | rssi %d | hellos %u | nets %lu\n",
      name, friendNear(f) ? "nearby" : "away", (unsigned long)((millis() - f.lastMs) / 1000),
      f.rssi, f.hellos, (unsigned long)f.nets);
  }
}

// ================================================================
//  Button: short press flips OLED page, hold >2 s to force a re-search
// ================================================================
static void buttonTick() {
  static bool     pressing      = false;
  static bool     triggered     = false;
  static uint32_t pressStartMs  = 0;

  bool low = (digitalRead(BTN_PIN) == LOW);

  if (low && !pressing) {
    pressing = true; triggered = false; pressStartMs = millis();
  }
  if (!low) {
    // Released: a short press (debounced, not already a long press) flips the page
    if (pressing && !triggered && (millis() - pressStartMs >= 30)) {
      oledPage = (oledPage + 1) % PAGE_COUNT;
    }
    pressing = false; triggered = false;
  }
  if (pressing && !triggered && (millis() - pressStartMs >= 2000)) {
    triggered = true;
    Serial.println("[BTN] Long press — re-searching for Core...");
    WiFi.scanDelete();
    resetToSearching();
  }
}

// ================================================================
//  setup()
// ================================================================
void setup() {
  Serial.begin(115200);
  delay(200);
  Serial.println();
  Serial.println("=== PigletNode C3 Boot " FIRMWARE_VERSION " ===");
  Serial.printf("JCMK channels: %d (2.4 GHz only on C3)  |  home ch: %d\n",
                NUM_CHANNELS, ESPNOW_CH);

  pinMode(LED_PIN, OUTPUT);
  ledWrite(false);
  pinMode(BTN_PIN, INPUT_PULLUP);

  oled.setBusClock(400000);  // fast I2C so 10 fps frames take ~10 ms
  oled.begin();
  oled.setContrast(255);
  oledMessage("PigletNode", "C3 " FIRMWARE_VERSION, "Booting...");

  // WiFi: full deinit → clean STA reinit (see upstream notes).
  WiFi.mode(WIFI_OFF);
  delay(100);
  WiFi.mode(WIFI_STA);
  WiFi.setAutoReconnect(false);
  WiFi.persistent(false);
  delay(100);

  esp_err_t err = esp_now_init();
  if (err != ESP_OK) {
    Serial.printf("[NODE] esp_now_init FAILED: %d\n", (int)err);
    char buf[20];
    snprintf(buf, sizeof(buf), "err %d", (int)err);
    oledMessage("ESP-NOW FAIL", buf, "Power-cycle");
    while (true) {
      ledWrite(true);  delay(50);
      ledWrite(false); delay(50);
    }
  }
  esp_now_register_recv_cb(onRecv);
  esp_read_mac(myMac, ESP_MAC_WIFI_STA);   // our own address, to pick the party leader

  delay(50);
  setChannel(ESPNOW_CH);
  { uint8_t pri; wifi_second_chan_t sec; esp_wifi_get_channel(&pri, &sec);
    Serial.printf("[NODE] Channel after set: %d (target=%d)%s\n", pri, ESPNOW_CH,
      (pri == ESPNOW_CH) ? " OK" : " *** MISMATCH!");
    if (pri != ESPNOW_CH) { delay(50); setChannel(ESPNOW_CH);
      esp_wifi_get_channel(&pri, &sec);
      Serial.printf("[NODE] Channel after retry: %d\n", pri); }
  }
  addPeer(JCMK_BCAST);

  // BLE after Wi-Fi/ESP-Now, so the radio coexistence scheduler has both
  bleInit();
  Serial.println("[NODE] BLE scanner ready");

  // Random stagger (200-3000 ms) so multiple nodes don't flood the Core together
  uint32_t stagger = (uint32_t)(esp_random() % 2800) + 200;
  Serial.printf("[NODE] Stagger %lu ms...\n", (unsigned long)stagger);
  delay(stagger);

  nodeActive = true;
  Serial.println("[NODE] Ready — searching for Core on ch 6...");
}

// ================================================================
//  loop()
// ================================================================
void loop() {
  nodeTick();
  ledTick();
  buttonTick();
  statusTick();
  friendsTick();
  oledTick();
  delay(10);
}
